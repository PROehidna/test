/*========================================================================================================
**Проект: "USART-Эхо".
**Назначение программы: принять по USART пакеты данных от ПК и вернуть их обратно
**Разработчик: Чеботин Тимофей Александрович - ИЦЭ
**Цель: продемонстрировать основы программирования USART микроконтроллера STM32F072RBT
**Решаемые задачи:
**				1. Конфигурирование линий GPIO на выполнение альтернативных функций;
**				2. Конфигурирование USART;
**				3. Демонстрация базовых принципов и передачи данных с помощью интерфейса USART (без использования прерываний)
**-========================================================================================================*/
#include "main.h"

int main(void)
{
	InitUSART1(); // Инициализация USART1 лабораторного компонента STM_01
	
	while(1)
	{
		// Получение данных из USART
		while ((USART1->ISR & USART_ISR_RXNE) == 0) {} // Чтение регистра состояния ISR и анализ флага RXNE: RXNE выставляется USART в 1, когда новый пакет данных получен приемником Rx и скопирован в RDR
		uint8_t d = (uint8_t)USART1->RDR;							 // Копирование данных из USART (регистр RDR) в программную переменную.
		// Чтение регистра RDR приводит к сбросу флага RXNE=0, после чего USART снова получает возможность просигналить программе о получении нового пакета от ПК
			
		// Отправка данных в USART
			while ((USART1->ISR & USART_ISR_TXE) == 0) {}  /* Чтение регистра состояния ISR и анализ флага TXE:
				TXE=0, пока данные из регистра IDR не скопированы в сдвиговый регистр передатчика Tx.
				TXE автоматически выставляется USART в 1, когда копирование из TDR в сдвиговый регистр завершено
				и регистр TDR готов к получению следующего пакета */
		USART1->TDR = d;	// Передача данных из программной переменной в USART (регистр TDR).
				// Запись в регистр TDR приводит к сбросу флага TXE=0.
	}
}

// Функция инициализации USART лабораторного комплексов STM_01
void InitUSART1(void)
{
	// Включение тактирования USART1
	RCC->APB2ENR |= RCC_APB2ENR_USART1EN;
	// Включение тактирования порта А
	RCC->AHBENR |= RCC_AHBENR_GPIOAEN;
	// Настройка линий порта А: PA9(TX_1) - выход передатчика; PA10(RX_1) - вход приемника
	GPIOA->MODER |= 0x00280000;	// Перевести линии PA9 и PA10 в режим альтернативной функции
	GPIOA->AFR[1] |= 0x00000110;	// Включить на линиях PA9 и PA10 альтернативную функцию AF1
	// Настройка линии передатчика Tx (PA9)
	GPIOA->OTYPER &= ~GPIO_OTYPER_OT_9;	// Сбросить 9 бит GPIOA->OTYPER - переключение в режим push-pull для линии PA9 (активный выход)
	GPIOA->PUPDR &= ~GPIO_PUPDR_PUPDR9;	// Отключение подтягивающим резисторов для линии PA9
	GPIOA->OSPEEDR |= GPIO_OSPEEDR_OSPEEDR9;	// Установка высокой скорости синхронизации линии PA9
	// Настройка линии приемника Rx (PA10)
	GPIOA->PUPDR &= ~GPIO_PUPDR_PUPDR10;	// Сброс режима подтягивающих резисторов для линии PA10
	GPIOA->PUPDR |= GPIO_PUPDR_PUPDR10_0; // Включение подтягивающего резистора pull-up на входной линии PA10 (вход приемника Rx)
	// Конфигурирование USART
	USART1->CR1 &= ~USART_CR1_UE;	// Запрет работы работы модуля USART1 для изменения параметров его конфигурации
	USART1->BRR = 69;							/* Настройка делителя частоты, тактирующего USART и задающего скорость приема и передачи данных на уровне
	115200 бит/с: Частота тактирующего генератора = 8 МГц;
	Скорость обмена по USART = 115200 бит/с; коэффициент деления = 8000000/11520 = 69,4444(4); Округление до значения 69 */
	
	USART1->CR1 = USART_CR1_TE | USART_CR1_RE; /* Разрешить работу приемника и передатчика USART. Остальные биты этого регистра сброшены,
	что обеспечивает: количество бит данных в пакете = 8;
	Контроль четности - отключен; Прерывания по любым флагам USART - запрещены; состояние USART - отключен */	
	USART1->CR2 = 0; // Количество стоповых бит - 1
	USART1->CR3 = 0; // DMA1 - отключен
	USART1->CR1 |= USART_CR1_UE;	// По завершении конфигурирования USART разрешить его работу (биту UE регистра CR1 присвоить 1).
	// Конфигурирование USART можно выполнять только в неактивном состоянии: UE = 0.
}
