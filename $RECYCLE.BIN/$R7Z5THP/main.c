//--------------------------------------------------------------------------------------------------------------------------------------------------------------------------------------------------------------------------------------------------*/
//Разработчит проекта: Доронин Всеволод Михайлович, студент группы 1192б.
//
//Цель: разработать программу для принятия пакетов данных ПК по USART и возвращения их обратно.
//
//Решамые проектом задачи:
//	1. Реализация сервера (стенд STM_01) для принятия пакетов данных и отправки из обратно в теримнал PuTTY.
//	2. Реализация вывода кода ASCII символа в заданной системе счисления.
//--------------------------------------------------------------------------------------------------------------------------------------------------------------------------------------------------------------------------------------------------*/
#include "main.h" 																																	/* Заголовчоный файл с описанием подключаемых библиотечных модулей 																																												     	*/
																																										/*																																																																											   	    */																																																																																																																	 /* */																																																																																																																																															 /* */
																																										/* main() - обязательная функция для исполнения кода пользователя. 																																											   	    */
																																										/* После подачи питания или щелчка кнопкой "reset" стартует Загрузчик, который выполняет начальную настройку основых регистров микроконтроллер						 	    */
																																										/* В завершение работы Загрузчик передаёт управление микроконтроллером функции main. 																																		   	    */
																																										/*  																																																																														*/																							
int main(void)																																			/*  																																																																														*/
{																																										/*  																																																																														*/
	InitUSART1();																																			/* Инициализация USART1 лабораторного комплекса STM_01. 																																																				*/
	uint16_t bitness = 4;																															/* Декларация переменной порядка системы счисления. 																																																						*/
																																										/*  																																																																														*/
	uint8_t out[4] = {0, 0, 0, 0};																										/* Массив вывода кода числа. 																																																																		*/
	uint8_t msg[] = {100, 118, 109, 45, 52, 62};																			/* Сообщение вида dvm-4>, что обозначает инициалы разработчика и систему счисления, в которой выводится число.																								  */
																																										/*  																																																																														*/
	while(1)																																					/*  																																																																														*/
	{																																									/*  																																																																														*/
		while ((USART1->ISR & USART_ISR_RXNE) == 0) {}																	/* Чтение регистров ISR и анализ флага RXNE. 																																																										*/
		uint8_t d = (uint8_t)USART1->RDR;																								/* Кодирование данных из регистра USART (регистр RDR) в программную переменную.																																									*/
																																										/* 														 																																																																	*/
		for (uint32_t i = 0; i < 12; i++)																								/* Удаление введенных ранее символов. 																																																													*/
			{																																							/*  																																																																														*/
				while ((USART1->ISR & USART_ISR_TXE) == 0) {}																/*  																																																																														*/
				USART1->TDR = 127;																													/* Чтение данных из регистра. 																																																																	*/
			}																																							/*  																																																																														*/
																																										/*  																																																																														*/
		for (uint32_t i = 0; i < 6; i++)																								/* Вывод сообщения dvm-4>.																																																																			*/
			{																																							/*  																																																																														*/
				while ((USART1->ISR & USART_ISR_TXE) == 0) {}																/* Передача данных в регистр. 																																																																	*/
				USART1->TDR = msg[i];																												/* Чтение данных из регистра. 																																																																	*/
			}																																							/*  																																																																														*/
																																										/*  																																																																														*/
		for (uint16_t i = 0 ; i<bitness; i++)																						/* Перевод числа в четырнадцатиричную систему.  											  																																												*/
		{         																																			/*  																																																																														*/
			if(d<bitness) 																																/* Проверка на размер числа относительно разрядности. Если число меньше - условие не сработает. 																	            									*/
			{																																							/*  																																																																														*/
				out[i] = d;																																	/* Запись значения числа в выходной массив. 																																																										*/
				break;																																			/* Прерывание цикла. 																																																																						*/
			}																																							/*  																																																																														*/
			out[i] = d%bitness;																														/* Запись остатка от деления числа в выходной массив. 																																																					*/
			d = d/bitness;																																/* Число перезаписывается и становится целочисленным остатком от деления на разрядность.  																																			*/
		} 																																							/*  																																																																														*/
																																										/*  																																																																														*/
		for (int32_t i = 3; i > -1; i--)																								/* Вывод массива с данными числа в обратном порядке. 																																																						*/
		{																																								/*  																																																																														*/
			while ((USART1->ISR & USART_ISR_TXE) == 0) {}																	/* Передача данных в регистр. 																																																																	*/
			USART1->TDR = out[i];																													/* Чтение данных из регистра. 																																																																	*/
		}																																								/*  																																																																														*/
																																										/* Конец строки. 																																																																								*/
		while ((USART1->ISR & USART_ISR_TXE) == 0) {}																		/* Передача данных в регистр. 																																																																	*/
		USART1->TDR = 0x00;																															/* Чтение данных из регистра. 																																																																	*/																										
																																										/*  																																																																														*/
		for (uint16_t k = 0; k < 4; k++)																								/*  																																																																														*/
			{																																							/*  																																																																														*/
				out[k] = 0;																																	/* Обнуление данных из массива с числом. 																																																												*/
			}																																							/*  																																																																														*/
	}																																									/*  																																																																														*/
}																																										/*  																																																																														*/
																																										/*  																																																																														*/
void InitUSART1(void)																																/* Функция инициализации USART лабораторного комплекса STM0_1.                                                                                                  */
{																																										/*  																																																																												    */
	RCC->APB2ENR |= RCC_APB2ENR_USART1EN;																							/* Включение тактирования USART1. RCC_APB2ENR_USARRT1EN=0x00004000.                                                                                             */
	RCC->AHBENR |= RCC_AHBENR_GPIOAEN;																								/* Включение тактирования порта A. RCC_AHBENR_GPIOAAEN=0x00020000.                                                                                              */
																																										/* Настройка линий порта A: PA9(TX_1) - выход передатчика; PA10 (RX_1) - вход приемника.                                                                        */
	GPIOA->MODER |= 0x00280000;																												/* Перевести линии PA.9 и PA.10 в режим альтернативной функции.                                                                                                 */
	GPIOA->AFR[1] |= 0x00000110;																											/* Включить на линиях PA.9 и PA.10 альтернативнуж функцию AF1.                                                                                                  */
																																										/* Настройка линии передатчика Tx (PA.9).                                                                                                                       */
	GPIOA->OTYPER &= ~GPIO_OTYPER_OT_9;																								/* Сбросить 9 бит GPIOA->OTYPER - переключение в режим push-pull для линии PA.9 (активный выход).                                                               */
	GPIOA->PUPDR &= ~GPIO_PUPDR_PUPDR9;																								/* Отключение подтягивающих резисторов для линии PA.9.                                                                                                          */
	GPIOA->OSPEEDR |= GPIO_OSPEEDR_OSPEEDR9;																					/* Установка высокой скорости синхронизации для линии PA.10.                                                                                                    */
																																										/* Настрйока линии приемника Rx (PA.10).                                                                                                                        */
	GPIOA->PUPDR &= ~GPIO_PUPDR_PUPDR10;																							/* Сброс режима подтягивающих резисторов для линии PA.9.                                                                                                        */
	GPIOA->PUPDR |= GPIO_PUPDR_PUPDR10_0;																							/* Включение подтягивающего резистора pull-up на входной линии PA.10 (вход приемника Rx)                                                                        */
																																										/* Конфигурирование USART.                                                                                                                                      */
	USART1->CR1 &= ~USART_CR1_UE;																											/* Запрещение работы модуля USART1 для изменения параметров его конфигруации.                                                                                   */
	USART1->BRR = 69;																																	/* Настройка делителя частоты тактирующего USART и задающего скорость приема и передачи данных на уровне 115200 бит/с: Частота тактирующего генератора = 8 МГц;	*/
																																										/* Скорость обмена по USART = 115200 бит/с; коэффициент деления = 8000000 / 115200 = 69(4)                             																				  */
	USART1->CR1 = USART_CR1_TE | USART_CR1_RE;																				/* Разрешить работу п=риемника и передатчика USART. Остальные биты этого регистра сброшены, что обесипечивает: количество бит данных в пакете = 8;              */
																																										/* контроль четности - отключен (четный не работает); прерывания по любым флагам USART - запрещены; состояние USART - отключен.                                        */
	USART1->CR2 = 0x3000;																															/* Количетсво стоп-бит - 1,5.                                                                                                                                 	*/
	USART1->CR3 = 0;																																	/* DMA1 - отключен                                                                                                                                              */
	USART1->CR1 |= USART_CR1_UE;																											/* По завершении конфигурирования USART разрешить его работу (биту UE регистра CR1 присвоить 1).                                                                */
}																																										/* Примечание: конфигурирование USART можно выполнить только в не активном состояниии: UE=0.                                                                    */																																										/*  */
//--------------------------------------------------------------------------------------------------------------------------------------------------------------------------------------------------------------------------------------------------*/
//Руководство пользователя:
//		1. Для запуска загруженной программы удалите перемычку "boot" на стенде и нажмите кнопку "reset".
//		2. Для запуска терминала сконфигурирутйе PuTTY на входную скорость в 19200 бодов, количество стоп-бит в 1,5 и подлкючитесь к нужному COM-порту.
//		3. При нажатии на клавишу в терминале PuTTY будет выведено сообщениие "dvm-4>xxxx", где 'dvm' - инициалы разработчика проекта, '-4>' система счисления, 'xxxx' - число в заданной системе счисления.
//--------------------------------------------------------------------------------------------------------------------------------------------------------------------------------------------------------------------------------------------------*/
