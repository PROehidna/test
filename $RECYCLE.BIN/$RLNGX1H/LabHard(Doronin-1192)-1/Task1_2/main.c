//------------------------------------------------------------------------------------------------------------------------------------------------------------------------------------------------------------------------------------------------------------------------------------------------------------------------------------------------------------------*/
//Разработчит проекта: Доронин Всеволод Михайлович, студент группы 1192б.
//
//Цель: разработать программу, реализующую мигание свтеодиодов в 4 режимах работы: последовательно включение и последовательное выключение светодиодов; последовательное зажигаение одного светодиода; и 2 реверсивных режима работы. 
//
//Решамые проектом задачи:
//	1. Реализовать режим, при котором последовательно загораются слева направо, а потом последовательно слева направо гаснут светодиоды
//	2. Реализовать режим, при котором слева направо «бежит» один огонек
//	3. Реализовать выбор режима работы используя микропереключатель SW1
//	4. Реализовать реверсный режим микропереключателем SW2
//	5. Реализовать управление временем задержки используя микропереключатели SW3 и SW4
//------------------------------------------------------------------------------------------------------------------------------------------------------------------------------------------------------------------------------------------------------------------------------------------------------------------------------------------------------------------*/
#include "main.h" 																																																				 /* Заголовчоный файл с описанием подключаемых библиотечных модулей. 																																																				 																															*/
																																																													 /*																																																																																			    									    																				*/																																																																																																																	 /* */																																																																																																																																															 /* */
																																																													 /* main() - обязательная функция для исполнения кода пользователя. 																																																			  																														  */
																																																													 /* После подачи питания или щелчка кнопкой "reset" стартует Загрузчик, который выполняет начальную настройку основых регистров микроконтроллера. 												  																														  */
																																																													 /* В завершение работы Загрузчик передаёт управление микроконтроллером функции main. 																																										  																														  */
																																																													 /*																																																																																	  		   																															*/																																																																																																																	 /* */
int main(void) 																																																				  	 /*																																																																																																																			  */
{																																																											  	 /*																																																																																																																				*/
	uint32_t half_period; 																																															  	 /* Половина переиода мигания светодиода.																																																							 					             																															*/
	uint32_t n; 																																																				  	 /* Степень коэффициента базовой задержки K=2^n.																																																							               																															*/
	uint32_t swreg; 																																																		  	 /*	Переменная положения SW1 для считывания режима работы. 																																																						       																															*/
	uint32_t swrev; 																	  																																  	 /*	Переменная положения SW2 для считывания реверсных режимов. 																																																						   																															*/
	RCC->AHBENR|=RCC_AHBENR_GPIOBEN; 											                                                                   /*	Включение тактирования порта B RCC_AHBENR_GPIOBEN=0x00040000 -> 18 бит данного регистра отвечает за вкл./выкл. тактирования порта B. 																		 																															*/
	GPIOB->MODER|=GPIO_MODER_MODER0_0 | GPIO_MODER_MODER1_0 | GPIO_MODER_MODER2_0 | 											                   /*	Переключение линий 0-8 порта B в режим "Output": 													GPIO_MODER_MODER0_0=0x1;    GPIO_MODER_MODER1_0=0x4;  	 GPIO_MODER_MODER2_0=0x10;   					 																															*/
								GPIO_MODER_MODER3_0 | GPIO_MODER_MODER4_0 | GPIO_MODER_MODER5_0 |											 									   /* Тождественно будет написать GPIOB->MODER|=0x15555													GPIO_MODER_MODER3_0=0x40;   GPIO_MODER_MODER4_0=0x100;  GPIO_MODER_MODER5_0=0x400;	 					 																															*/
								GPIO_MODER_MODER6_0 | GPIO_MODER_MODER7_0 | GPIO_MODER_MODER8_0;																					 /*																									 													GPIO_MODER_MODER6_0=0x1000; GPIO_MODER_MODER7_0=0x4000; GPIO_MODER_MODER8_0=0x1000. 					 																															*/
	GPIOB->OSPEEDR|=0X5555;																												 																					 /*	С помощью регистра GPIOx_OSPEEDR осущетсвляется переключениие скорости синхронизации линий 0-7 порта B на скорость в 1 0МГц. HEX значение соответствует 0b01 для кажой пары битов в линии порта, т.к. на каждую линию уходит 2 бита.  */
	GPIOB->MODER&=~( GPIO_MODER_MODER12 | GPIO_MODER_MODER13 | GPIO_MODER_MODER14 | GPIO_MODER_MODER15); 								  	 /*	Переключение 12-15 (SW4-SW1) линий порта в режим "Input" -> положение 00 для каждой пары битов в данном регистре соответствует режиму ввода данных.											 																															*/
	GPIOB->ODR|=0x100; 																																																		 	 /*	Разрешение работы светодиодов на стенде STM_01 с помощью установки логической "1" на выводе PB.8.																																																																			*/
	half_period = 50000; 																																																	 	 /*	Задание величины базовой задержки. 																																																																																																		*/
	uint32_t on[] = {0x1, 0x2, 0x4, 0x80, 0x40, 0x20, 0x10, 0x8};											 																			 /*	Массив с данными о битах для включенных диодов.																																																																																												*/
	uint32_t off[] = {0x10000, 0x20000, 0x40000, 0x800000, 0x400000, 0x200000, 0x100000, 0x80000};											     /*	Массив с данными о битах для выключенных диодов.																																																																																											*/
	while(1)											                                                                                           /*																																																																																																																				*/
	{											                                                                                                   /*																																																																																																																				*/
		n=((GPIOB->IDR)&0x3000)>>12;											                                                                     /*	Определение степени коэффициента базовой задержки: K=2^n. Регистром GPIOx_IDR считываются данные о положении 12 и 13 линий порта B.																																																		*/
		swreg=((GPIOB->IDR)&0x8000)>>15;											                                                                 /*	Определение режима работы. Регистром GPIOx_IDR считываются данные о положении 15 линии порта B. 																																																																			*/
		swrev=((GPIOB->IDR)&0x4000)>>14;																																											 /*	Определение реверсного режима работы. Регистром GPIOx_IDR считываются данные о положении 14 линии порта B.																																																														*/
		
		uint32_t diodeMode =((GPIOB->IDR)&0xC000)>>14;
		switch (diodeMode){
			case (0):
				GPIOB->BSRR=0x100;																																																 /*	Разрешение работы светодиодов на стенде STM_01 с помощью установки логической "1" на выводе PB.8.																																																																			*/
				for (uint32_t i = 0; i<8; i++)																																										 /*	Цикл для отработки массива on[]. Включение светодиодов. 																																																																																							*/
				{ 																																																							   /*																																																																																																																				*/	
					GPIOB->BSRR=on[i]; 											 																																				 /*	Установка битов согласно заданными в массиве "включения" данными.																																																																																			*/
					delay(half_period<<n);																																													 /*	Задержка после включения светодиода.																																																																																																	*/
				} 																																																							 	 /*																																																																																																																				*/
				for (uint32_t j =0; j<8; j++) 											 																															 /*	Цикл для отработки массива off[].	Выключение светодиодов.																																																																																							*/
				{																																																									 /*																																																																																																																				*/
					GPIOB->BSRR=off[j];											 																																				 /*	Установка битов  согласно заданными в массиве "выключения" данными.																						  																																																											*/
					delay(half_period<<n);																																													 /* Задержка после включения светодиода.																																																																																																	*/
				}		
				continue;
			case (1):
				GPIOB->BSRR=0x100; 																																											           /*	Разрешение работы светодиодов на стенде STM_01 с помощью установки логической "1" на выводе PB.8.																																																																			*/
				for (uint32_t i = 0; i<8; i++) 																																										 /*	Цилк для отрбаотки массивов on[] и off[]. Включенние и выключенние светодиодов.																																																																												*/
				{ 																																																								 /*																																																																																																																				*/
					GPIOB->BSRR=on[i]; 																																															 /*	Установка битов согласно заданными в массиве "включения" данными.																																																																																			*/
					delay(half_period<<n); 																																													 /*	Задержка после включения светодиода.																																																																																																	*/
					GPIOB->BSRR=off[i];																																															 /*	Установка битов согласно заданными в массиве "выключения" данными.																																																																																		*/
				} 	
				continue;
			case (2):
					GPIOB->BSRR=0x100;																																															 /*	Разрешение работы светодиодов на стенде STM_01 с помощью установки логической "1" на выводе PB.8.																																																																			*/
					for (int32_t i = 7; i > -1; i--) 																																								 /*	Цикл для отработки массива on[]. Включение светодиодов.																																																																																								*/
					{ 																																																							 /*																																																																																																																				*/
						GPIOB->BSRR=on[i]; 											 																																			 /*	Установка битов согласно заданными в массиве "включения" данными.																																																																																			*/
						delay(half_period<<n);																																												 /*	Задержка после включения светодиода.																																																																																																	*/
					} 																																																							 /*																																																																																																																				*/
					for (int32_t j = 7; j > -1; j--) 																																								 /*	Цикл для отработки массива off[].	Выключение светодиодов.																																																																																							*/
					{ 																																																							 /*																																																																																																																				*/
						GPIOB->BSRR=off[j];											 																																			 /*	Установка битов согласно заданными в массиве "выключения" данными. 																																																																																		*/
						delay(half_period<<n);																																												 /* Задержка после включения светодиода.																																																																																																	*/
					}	
				continue;
			case (3):
					GPIOB->BSRR=0x100;																																															 /*	Разрешение работы светодиодов на стенде STM_01 с помощью установки логической "1" на выводе PB.8.																																																																			*/
					for (int32_t i = 7; i > -1; i--) 																																								 /*																																																																																																																				*/
					{ 																																																							 /*																																																																																																																				*/
						GPIOB->BSRR=on[i]; 																																														 /*	Установка битов согласно заданными в массиве "включения" данными.																																																																																			*/
						delay(half_period<<n); 																																												 /*	Задержка после включения светодиода.																																																																																																	*/
						GPIOB->BSRR=off[i];																																														 /*	Установка битов согласно заданными в массиве "выключения" данными.																																																																																		*/
					} 
				continue;
		
				}																																																							 /*																																																																																																																				*/
		}																																																											 /*																																																																																																																				*/
} 																																																												 /*																																																																																																																				*/
																																																													 /*	Функция задержки: count - количество элементарных периодов задрежки с длительностью примерно 2.5 мкс. 																																																																*/
void delay(uint32_t count)      																																													 /*																																																																																																																				*/
{ 																																																												 /*																																																																																																																				*/
for (uint32_t i=0;i<count;i++);																																													   /*	Выполнение пустых циклов для реализации программной задержки.																																																																																					*/
} 																																																												 /*																																																																																																																				*/
//------------------------------------------------------------------------------------------------------------------------------------------------------------------------------------------------------------------------------------------------------------------------------------------------------------------------------------------------------------------*/
//Руководство пользователя:
//		1. Для запуска загруженной программы удалите перемычку "boot" на стенде и нажмите кнопку "reset".
//		2. В управлении частотой мигания светодиода используйте микропереключатели SW3(старший разряд) и SW4 (младший разряд).
//		3. Примерная частота мигания: 00 - 4 Гц; 01 - 2 Гц; 10 - 1 Гц; 11 - 0.5 Гц.
//		4. В управлении режимом работы используйте переключатель SW1.
//		5. В управлении реверсивным режимом работы используйте переключатель SW2.
//		6. Интервал между переключениями светодиода задается с помощью программной задержки.
//------------------------------------------------------------------------------------------------------------------------------------------------------------------------------------------------------------------------------------------------------------------------------------------------------------------------------------------------------------------*/

